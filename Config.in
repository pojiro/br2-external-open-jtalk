## Config.in
```kconfig
source "$BR2_EXTERNAL_OPEN_JTALK_PATH/package/open_jtalk/Config.in"
source "$BR2_EXTERNAL_OPEN_JTALK_PATH/package/hts_engine_API/Config.in"
```

## package/hts_engine_API/Config.in
```kconfig
config BR2_PACKAGE_HTS_ENGINE_API
	bool "hts_engine_API"
	help
	  The hts_engine is software to synthesize speech waveform
	  from HMMs trained by the HMM-based speech synthesis system (HTS).

	  https://hts-engine.sourceforge.net/
```

## package/open-jtalk/Config.in
```kconfig
config BR2_PACKAGE_OPEN_JTALK
	bool "open-jtalk"
	select config BR2_PACKAGE_HTS_ENGINE_API
	help
	  Open JTalk is a Japanese text-to-speech synthesis system.
	  This software is released under the Modified BSD license.

	  https://open-jtalk.sourceforge.net/
```
